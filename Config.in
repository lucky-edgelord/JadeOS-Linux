## Config.in
```kconfig
source "$BR2_EXTERNAL_JADEOS_PATH/package/jadeos/Config.in"
source "$BR2_EXTERNAL_JADEOS_PATH/package/jflite/Config.in"
```

## package/jadeos-host/Config.in
```kconfig
config BR2_PACKAGE_JADEOS_HOST
	bool "jadeos-host"
	depends on BR2_PACKAGE_NODEJS
	help
	  jaded (the native host daemon) and the Jade Vault page it serves.
	  Needs a built Jade Vault checkout (dist/jade-vault.html): set
	  JADEOS_HOST_OVERRIDE_SRCDIR in local.mk, as scripts/build.sh does.
```

## package/jadeos/Config.in
```kconfig
config BR2_PACKAGE_JADEOS
	bool "jadeos"
	depends on BR2_PACKAGE_NODEJS
	help
	  jaded (the native host daemon) and the Jade Vault page for
	  JadeOS-Linux.
```

## package/jflite/Config.in
```kconfig
config BR2_PACKAGE_JFLITE
	bool "flite (for jaded's speech fallback)"
	depends on BR2_USE_WCHAR
	help
	  Flite, the small CMU speech synthesiser, built as a separate package from Buildroot's own `flite` so that
	  WPE WebKit does not switch on its (unbuildable without multimedia) speech synthesis support when it sees it.
```
